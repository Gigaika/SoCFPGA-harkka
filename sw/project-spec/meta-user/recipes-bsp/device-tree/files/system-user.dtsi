/include/ "system-conf.dtsi"
/ {
      dma_proxy {
          compatible = "xlnx,dma_proxy";
          dmas = <&axi_dma_0 0
                  &axi_dma_1 0>;
          dma-names = "dma_proxy_tx", "dma_proxy_rx";
      };
      chosen {
          bootargs = "console=ttyPS0,115200 earlycon uio_pdrv_genirq.of_id=generic-uio";
      };
};


&ImageClassifier_0 {
    compatible = "generic-uio";
};
